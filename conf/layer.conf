## conf/layer.conf
```bitbake
# We have a conf and classes directory, add to BBPATH
BBPATH .= ":${LAYERDIR}"

# We have recipes-* directories, add to BBFILES
BBFILES += "${LAYERDIR}/recipes-*/*/*.bb \
            ${LAYERDIR}/recipes-*/*/*.bbappend"

BBFILE_COLLECTIONS += "meta-layer-example"
BBFILE_PATTERN_meta-layer-example = "^${LAYERDIR}/"
BBFILE_PRIORITY_meta-layer-example = "6"

LAYERDEPENDS_meta-layer-example = "core"
LAYERSERIES_COMPAT_meta-layer-example = "gatesgarth"
```
